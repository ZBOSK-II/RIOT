## boards/zedboard-noelv/Kconfig
```kconfig
config BOARD
    default "zedboard-noelv" if BOARD_ZEDBOARD_NOELV

config BOARD_ZEDBOARD_NOELV
    bool
    default y
    select CPU_CORE_RV64IMAC
```

## cpu/noelv/Kconfig
```kconfig
# SPDX-FileCopyrightText: 2020 Inria
# SPDX-FileCopyrightText: 2026 Matvii Ivashchenko
# SPDX-License-Identifier: LGPL-2.1-only

config CPU_ARCH_RISCV
    bool

config CPU_CORE_RV32IMAC
    bool
    select CPU_ARCH_RISCV

config CPU_CORE_RV64IMAC
    bool
    select CPU_ARCH_RISCV

config CPU_CORE
    default "rv32imac" if CPU_CORE_RV32IMAC
    default "rv64imac" if CPU_CORE_RV64IMAC

config CPU_ARCH
    default "rv32" if CPU_CORE_RV32IMAC
    default "rv64" if CPU_CORE_RV64IMAC
```
